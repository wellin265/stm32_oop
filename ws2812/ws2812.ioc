# file: ws2812.ioc
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Dma.Request0=TIM2_CH1
Dma.TIM2_CH1.0.Direction=DMA_MEMORY_TO_PERIPH
Dma.TIM2_CH1.0.Instance=DMA1_Channel5
Dma.TIM2_CH1.0.MemDataAlignment=DMA_MDATAALIGN_HALFWORD
Dma.TIM2_CH1.0.MemInc=DMA_MINC_ENABLE
Dma.TIM2_CH1.0.Mode=DMA_NORMAL
Dma.TIM2_CH1.0.PeriphDataAlignment=DMA_PDATAALIGN_HALFWORD
Dma.TIM2_CH1.0.PeriphInc=DMA_PINC_DISABLE
Dma.TIM2_CH1.0.Priority=DMA_PRIORITY_LOW
Mcu.Family=STM32F1
Mcu.Name=STM32F103C(8-B)Tx
Mcu.Package=LQFP48
NVIC.DMA1_Channel5_IRQn=true\:0\:0\:false\:false\:true\:false\:true\:true
NVIC.PriorityGroup=NVIC_PRIORITYGROUP_4
PA0-WKUP.GPIO_Speed=GPIO_SPEED_FREQ_HIGH
PA0-WKUP.Signal=S_TIM2_CH1_ETR
PA13.Mode=Serial_Wire
PA13.Signal=SYS_JTMS-SWDIO
PA14.Mode=Serial_Wire
PA14.Signal=SYS_JTCK-SWCLK
PC14-OSC32_IN.Mode=LSE-External-Oscillator
PC14-OSC32_IN.Signal=RCC_OSC32_IN
PC15-OSC32_OUT.Mode=LSE-External-Oscillator
PC15-OSC32_OUT.Signal=RCC_OSC32_OUT
PD0-OSC_IN.Mode=HSE-External-Oscillator
PD0-OSC_IN.Signal=RCC_OSC_IN
PD1-OSC_OUT.Mode=HSE-External-Oscillator
PD1-OSC_OUT.Signal=RCC_OSC_OUT
ProjectManager.HeapSize=0x200
ProjectManager.StackSize=0x400
ProjectManager.TargetToolchain=CMake
RCC.AHBFreq_Value=72000000
RCC.APB1CLKDivider=RCC_HCLK_DIV2
RCC.APB1Freq_Value=36000000
RCC.APB1TimFreq_Value=72000000
RCC.APB2Freq_Value=72000000
RCC.APB2TimFreq_Value=72000000
RCC.HCLKFreq_Value=72000000
RCC.PLLMUL=RCC_PLL_MUL9
RCC.PLLSourceVirtual=RCC_PLLSOURCE_HSE
RCC.SYSCLKFreq_VALUE=72000000
RCC.SYSCLKSource=RCC_SYSCLKSOURCE_PLLCLK
RCC.USBFreq_Value=72000000
SH.S_TIM2_CH1_ETR.0=TIM2_CH1,PWM Generation1 CH1
TIM2.AutoReloadPreload=TIM_AUTORELOAD_PRELOAD_ENABLE
TIM2.Channel-PWM\ Generation1\ CH1=TIM_CHANNEL_1
TIM2.Period=90 - 1
TIM2.Prescaler=0
VP_TIM2_VS_ClockSourceINT.Mode=Internal
board=custom

// file: Core/Src/main.c
/* USER CODE BEGIN Header */
/**
  ******************************************************************************
  * @file           : main.c
  * @brief          : Main program body
  ******************************************************************************
  * @attention
  *
  * Copyright (c) 2026 STMicroelectronics.
  * All rights reserved.
  *
  * This software is licensed under terms that can be found in the LICENSE file
  * in the root directory of this software component.
  * If no LICENSE file comes with this software, it is provided AS-IS.
  *
  ******************************************************************************
  */
/* USER CODE END Header */
#include "main.h"
#include "dma.h"
#include "tim.h"
#include "gpio.h"

/* USER CODE BEGIN Includes */
#include "ws2812.h"
/* USER CODE END Includes */

/* USER CODE BEGIN PV */
#define LED_COUNT     4
#define RESET_PULSES  80

static uint8_t  led_color[LED_COUNT * 3];
static uint16_t led_pwm[24 * LED_COUNT + RESET_PULSES];

static WS2812_S ws2812;
/* USER CODE END PV */

void SystemClock_Config(void);
/* USER CODE BEGIN PFP */
static void ws2812_test_all(void);
static void ws2812_test_chase(void);
/* USER CODE END PFP */

/* USER CODE BEGIN 0 */

/**
 * @brief  全部 4 颗 LED 同时切换: 红→绿→蓝→白→灭
 */
static void ws2812_test_all(void)
{
    ws2812.fill(&ws2812, 255, 0, 0);
    ws2812.send(&ws2812);
    ws2812.wait_done(&ws2812);
    HAL_Delay(300);

    ws2812.fill(&ws2812, 0, 255, 0);
    ws2812.send(&ws2812);
    ws2812.wait_done(&ws2812);
    HAL_Delay(300);

    ws2812.fill(&ws2812, 0, 0, 255);
    ws2812.send(&ws2812);
    ws2812.wait_done(&ws2812);
    HAL_Delay(300);

    ws2812.fill(&ws2812, 255, 255, 255);
    ws2812.send(&ws2812);
    ws2812.wait_done(&ws2812);
    HAL_Delay(300);

    ws2812.clear(&ws2812);
    ws2812.send(&ws2812);
    ws2812.wait_done(&ws2812);
    HAL_Delay(300);
}

/**
 * @brief  跑马灯: 每颗 LED 依次闪红→绿→蓝→白
 */
static void ws2812_test_chase(void)
{
    for (uint16_t i = 0; i < LED_COUNT; i++)
    {
        ws2812.clear(&ws2812);
        ws2812.set_led(&ws2812, i, 255, 0, 0);
        ws2812.send(&ws2812);
        ws2812.wait_done(&ws2812);
        HAL_Delay(100);

        ws2812.clear(&ws2812);
        ws2812.set_led(&ws2812, i, 0, 255, 0);
        ws2812.send(&ws2812);
        ws2812.wait_done(&ws2812);
        HAL_Delay(100);

        ws2812.clear(&ws2812);
        ws2812.set_led(&ws2812, i, 0, 0, 255);
        ws2812.send(&ws2812);
        ws2812.wait_done(&ws2812);
        HAL_Delay(100);

        ws2812.clear(&ws2812);
        ws2812.set_led(&ws2812, i, 255, 255, 255);
        ws2812.send(&ws2812);
        ws2812.wait_done(&ws2812);
        HAL_Delay(100);
    }
}
/* USER CODE END 0 */

int main(void)
{

  /* MCU Configuration--------------------------------------------------------*/

  /* Reset of all peripherals, Initializes the Flash interface and the Systick. */
  HAL_Init();

  /* Configure the system clock */
  SystemClock_Config();

  /* Initialize all configured peripherals */
  MX_GPIO_Init();
  MX_DMA_Init();
  MX_TIM2_Init();
  /* USER CODE BEGIN 2 */

  /* ---- 创建 WS2812 驱动对象 ---- */
  WS2812_CFG_S cfg = {
      .htim          = &htim2,
      .timer_channel = TIM_CHANNEL_1,
      .led_count     = LED_COUNT,
      .color_buf     = led_color,
      .pwm_buf       = led_pwm,
      .pwm_buf_size  = sizeof(led_pwm) / sizeof(uint16_t),
  };
  WS2812_Create(&ws2812, &cfg);

  /* ---- 启动验证: 4 颗同时亮绿色 2 秒 ---- */
  ws2812.fill(&ws2812, 0, 255, 0);
  ws2812.send(&ws2812);
  ws2812.wait_done(&ws2812);
  HAL_Delay(2000);

  /* ---- 逐颗不同颜色: 红/绿/蓝/白 2 秒 ---- */
  ws2812.clear(&ws2812);
  ws2812.set_led(&ws2812, 0, 255, 0,   0);   /* LED0 = 红   */
  ws2812.set_led(&ws2812, 1, 0,   255, 0);   /* LED1 = 绿   */
  ws2812.set_led(&ws2812, 2, 0,   0, 255);   /* LED2 = 蓝   */
  ws2812.set_led(&ws2812, 3, 255, 255, 255); /* LED3 = 白   */
  ws2812.send(&ws2812);
  ws2812.wait_done(&ws2812);
  HAL_Delay(2000);

  /* ---- 半亮度验证 2 秒 ---- */
  ws2812.set_brightness(&ws2812, 128);
  ws2812.send(&ws2812);
  ws2812.wait_done(&ws2812);
  HAL_Delay(2000);
  ws2812.set_brightness(&ws2812, 255);
  /* USER CODE END 2 */

  /* Infinite loop */
  /* USER CODE BEGIN WHILE */
  while (1)
  {
      ws2812_test_chase();
      HAL_Delay(300);
      ws2812_test_all();
      HAL_Delay(300);
      /* USER CODE END WHILE */

  }
}

void SystemClock_Config(void)
{
  RCC_OscInitTypeDef RCC_OscInitStruct = {0};
  RCC_ClkInitTypeDef RCC_ClkInitStruct = {0};

  RCC_OscInitStruct.OscillatorType = RCC_OSCILLATORTYPE_HSE;
  RCC_OscInitStruct.HSEState = RCC_HSE_ON;
  RCC_OscInitStruct.HSEPredivValue = RCC_HSE_PREDIV_DIV1;
  RCC_OscInitStruct.HSIState = RCC_HSI_ON;
  RCC_OscInitStruct.PLL.PLLState = RCC_PLL_ON;
  RCC_OscInitStruct.PLL.PLLSource = RCC_PLLSOURCE_HSE;
  RCC_OscInitStruct.PLL.PLLMUL = RCC_PLL_MUL9;
  if (HAL_RCC_OscConfig(&RCC_OscInitStruct) != HAL_OK)
  {
    Error_Handler();
  }

  RCC_ClkInitStruct.ClockType = RCC_CLOCKTYPE_HCLK|RCC_CLOCKTYPE_SYSCLK
                              |RCC_CLOCKTYPE_PCLK1|RCC_CLOCKTYPE_PCLK2;
  RCC_ClkInitStruct.SYSCLKSource = RCC_SYSCLKSOURCE_PLLCLK;
  RCC_ClkInitStruct.AHBCLKDivider = RCC_SYSCLK_DIV1;
  RCC_ClkInitStruct.APB1CLKDivider = RCC_HCLK_DIV2;
  RCC_ClkInitStruct.APB2CLKDivider = RCC_HCLK_DIV1;

  if (HAL_RCC_ClockConfig(&RCC_ClkInitStruct, FLASH_LATENCY_2) != HAL_OK)
  {
    Error_Handler();
  }
}

void Error_Handler(void)
{
  __disable_irq();
  while (1)
  {
  }
}
